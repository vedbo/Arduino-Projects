#include <Wire.h>
#include <Adafruit_SSD1306.h>
#include <Servo.h>

Servo myservo;

#include <Keypad.h>
 
#define SCREEN_WIDTH 128 // OLED display width, in pixels
#define SCREEN_HEIGHT 32 // OLED display height, in pixels
 
// Declaration for an SSD1306 display connected to I2C (SDA, SCL pins)
#define OLED_RESET 4 // Reset pin # (or -1 if sharing Arduino reset pin)
Adafruit_SSD1306 display(SCREEN_WIDTH, SCREEN_HEIGHT, &Wire, OLED_RESET);
 
#define Password_Length 5
 
const byte ROWS = 4;
const byte COLS = 4;
 
char hexaKeys[ROWS][COLS] = {
    {'1', '2', '3', 'A'},
    {'4', '5', '6', 'B'},
    {'7', '8', '9', 'C'},
    {'*', '0', '#', 'D'}};
 
byte rowPins[ROWS] = {9, 8, 7, 6};
byte colPins[COLS] = {5, 4, 3, 2};
 
char Data[Password_Length];
char Master[Password_Length] = "1357";
byte data_count = 0;
char customKey;
 
Keypad customKeypad = Keypad(makeKeymap(hexaKeys), rowPins, colPins, ROWS, COLS);
 

const unsigned char myBitmap [] PROGMEM = 

{
  0x00, 0x00, 0x00, 0x00, 0x00, 0x00, 0x00, 0x00, 0x00, 0x00, 0x00, 0x00, 0x00, 0x00, 0x00, 0x00, 
  0x00, 0x00, 0x00, 0x00, 0x00, 0x00, 0x00, 0x00, 0x00, 0x00, 0x00, 0x00, 0x00, 0x00, 0x00, 0x00, 
  0x00, 0x00, 0x00, 0x00, 0x00, 0x00, 0x00, 0x00, 0x00, 0x00, 0x00, 0x00, 0x00, 0x00, 0x00, 0x00, 
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  0x00, 0x00, 0x00, 0x00, 0x00, 0x00, 0x00, 0x00, 0x00, 0x00, 0x00, 0x00, 0x00, 0x00, 0x00, 0x00
};






void setup()
{
  Serial.begin(115200);
  myservo.attach(12);
  myservo.write(0);
 
  // SSD1306_SWITCHCAPVCC = generate display voltage from 3.3V internally
  // Address 0x3C for 128x32 or 0x3D for 128x64
  if (!display.begin(SSD1306_SWITCHCAPVCC, 0x3C))
  {
    Serial.println(F("SSD1306 allocation failed"));
    for (;;)
      ; // Don't proceed, loop forever
  }
 
  // Show initial display buffer contents on the screen --
  // the library initializes this with an Adafruit splash screen.
  display.display();
  delay(2000); // Pause for 2 seconds
 
  // Clear the display and show it.
  display.clearDisplay();
  display.display();
}
 
void loop()
{
  display.setCursor(0, 0);
  display.setTextSize(1.8); // Draw normal-scale text
  display.setTextColor(SSD1306_WHITE);
  display.print(F("Enter Med ID:"));
  display.display();
 
  customKey = customKeypad.getKey();
 
  if (customKey)
  {
    Data[data_count] = customKey;
    display.setCursor(data_count * 8, 20);
    display.print('*');
    display.display();
    data_count++;
  }
 
  if (data_count == Password_Length - 1)
  {
    display.clearDisplay();
    display.setCursor(0, 0);
 
    if (!strcmp(Data, Master))
    {
      // The passcode matches, so tell the user they can enter
      display.setTextSize(2); // Draw 3X-scale text
      display.print("  Welcome  ");
      display.print("  Ved  ");
      
      display.display();
      delay(4000);
      display.clearDisplay();
 display.drawBitmap(0, 0, myBitmap, 128, 64, WHITE);
  display.display();
      Serial.println("Open");
      myservo.write(90);
      delay(2000);
      myservo.write(0);
    }
    else
    {
      display.setTextSize(2); // Draw 2X-scale text
      display.setTextColor(SSD1306_BLACK, SSD1306_WHITE);
      display.print("  Access  Denied  ");
      display.display();
      Serial.println("Failed");
      delay(2000);
    }
    clearData();
    display.clearDisplay();
  }
}
 
void clearData()
{
  while (data_count != 0)
  {
    Data[data_count--] = 0;
  }
  return;
}